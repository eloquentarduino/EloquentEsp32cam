#pragma once

#ifndef ELOQUENT_ESP32CAM_VIZ_EI_FOMO_STREAM_H
#define ELOQUENT_ESP32CAM_VIZ_EI_FOMO_STREAM_H

#include "../../camera/Camera.h"
#include "../../extra/exception.h"
#include "../../extra/esp32/http/server.h"
#include "../../edgeimpulse/fomo.h"
#include "../mjpeg.h"

using eloq::camera;
using eloq::viz::mjpeg;
using eloq::ei::fomo;
using Eloquent::Error::Exception;
using Eloquent::Extra::Esp32::Http::HttpServer;
using OnObjectsCallback = std::function<void()>;

namespace Eloquent {
    namespace Esp32cam {
        namespace Viz {
            namespace EdgeImpulse {
                /**
                 * Show FOMO results in web browser
                 * overlayed over MJPEG stream
                 */
                class FOMOStream {
                    public:
                        Exception exception;
                        HttpServer server;

                        /**
                         * Constructor
                         */
                        FOMOStream() :
                            exception("FOMO Stream"),
                            server("FOMO Stream") {

                            }

                        /**
                         * Debug self IP address
                         */
                        String address() const {
                            return String("FOMO stream is available at http://") + wifi.ip();
                        }

                        /**
                         * Start server
                         */
                        Exception& begin() {
                            if (!mjpeg.begin().isOk())
                                return exception.propagate(mjpeg);

                            onIndex();
                            onEventStream();

                            return server.beginInThread(exception);
                        }

                        /**
                         * Register callback to run when something is detected
                         */
                         void whenYouSeeAnything(OnObjectsCallback callback) {
                             _onObjects = callback;
                         }

                    protected:
                        OnObjectsCallback _onObjects;

                        /**
                         * Display main page
                         */
                        void onIndex() {
                            server.onGET("/", [this](WebServer *web) {
                                static const uint8_t index[4851] = {31, 139, 8, 0, 0, 0, 0, 0, 0, 19, 149, 87, 109,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 0, 0};
                                server.sendGzip(index, 4851);
                            });
                        }


                        /**
                         * 
                         */
                        void onEventStream() {
                            server.onStream("/events", [this](WebServer *web, WiFiClient *client) {
                                if (!fomo.run().isOk()) {
                                    delay(100);
                                    client->print("err=");
                                    client->print(fomo.exception.toString());
                                    return;
                                }

                                if (!fomo.found()) {
                                    client->print("status=No objects found");
                                    return;
                                }

                                fomo.forEach([client](int i, eloq::ei::bbox_t bbox) {
                                    ESP_LOGI(
                                        "FOMO", 
                                        "id=%d,x=%d,y=%d,w=%d,h=%d,cx=%d,cy=%d,score=%.2f",
                                        i, 
                                        bbox.x, 
                                        bbox.y, 
                                        bbox.width, 
                                        bbox.height,
                                        bbox.cx,
                                        bbox.cy,
                                        bbox.proba
                                    );
                                    client->print("id=");
                                    client->print(i);
                                    client->print("&x=");
                                    client->print(((float) bbox.x) / EI_CLASSIFIER_INPUT_WIDTH);
                                    client->print("&y=");
                                    client->print(((float) bbox.y) / EI_CLASSIFIER_INPUT_HEIGHT);
                                    client->print("&w=");
                                    client->print(((float) bbox.width) / EI_CLASSIFIER_INPUT_WIDTH);
                                    client->print("&h=");
                                    client->print(((float) bbox.height) / EI_CLASSIFIER_INPUT_HEIGHT);
                                    client->print("&cx=");
                                    client->print(((float) bbox.cx) / EI_CLASSIFIER_INPUT_WIDTH);
                                    client->print("&cy=");
                                    client->print(((float) bbox.cy) / EI_CLASSIFIER_INPUT_HEIGHT);
                                    client->print("&score=");
                                    client->print(bbox.proba);
                                    client->print("|");
                                });

                                if (_onObjects)
                                    _onObjects();
                            }, 7000);
                        }
                };
            }
        }
    }
}

namespace eloq {
    namespace viz {
        namespace ei {
            static Eloquent::Esp32cam::Viz::EdgeImpulse::FOMOStream fomoStream;
        }
    }
}

#endif