#ifndef ELOQUENT_ESP32CAM_VIZ_FACE_STREAM_H
#define ELOQUENT_ESP32CAM_VIZ_FACE_STREAM_H

#include "../camera/Camera.h"
#include "../extra/exception.h"
#include "../extra/esp32/wifi/sta.h"
#include "../extra/esp32/http/server.h"
#include "../face/detection.h"
#include "./mjpeg.h"

using eloq::viz::mjpeg;
using eloq::face::detection;
using eloq::face_t;
using Eloquent::Error::Exception;
using Eloquent::Extra::Esp32::Http::HttpServer;
using Eloquent::Esp32cam::Face::FaceDetection;


namespace Eloquent {
    namespace Esp32cam {
        namespace Viz {
            /**
             * Show face detection result in browser
             */
            class FaceDetectionStream {
                public:
                    Exception exception;
                    HttpServer server;

                    /**
                     * Constructor
                     */
                    FaceDetectionStream() :
                        exception("FaceDetectionStream"),
                        server("FaceDetectionStream") {

                        }

                    /**
                     * Debug self IP address
                     */
                    String address() const {
                        return String("Face Detection stream is available at http://") + wifi.ip();
                    }

                    /**
                     * Start server
                     */
                    Exception& begin() {
                        if (!mjpeg.begin().isOk())
                            return exception.propagate(mjpeg);

                        onIndex();
                        onEventStream();

                        return server.beginInThread(exception);
                    }

                protected:

                    /**
                     * Display main page
                     */
                    void onIndex() {
                        server.onGET("/", [this](WebServer *web) {
                            static const uint8_t index[5264] = {31, 139, 8, 0, 0, 0, 0, 0, 0, 19, 173, 88, 109,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 0, 0};
                            server.sendGzip(index, 5264);
                        });
                    }

                    /**
                     * Send face recognitions
                     */
                    void onEventStream() {
                        server.onStream("/events", [this](WebServer *web, WiFiClient *client) {
                            if (!detection.run().isOk()) {
                                delay(100);
                                client->print("error=");
                                client->print(detection.exception.toString());
                                return;
                            }

                            if (detection.notFound()) 
                                return;

                            detection.forEach([client](int i, face_t face) {
                                ESP_LOGI(
                                    "FACE", 
                                    "id=%d,x=%d,y=%d,w=%d,h=%d",
                                    i, 
                                    face.x, 
                                    face.y, 
                                    face.width, 
                                    face.height
                                );

                                client->print("id=");
                                client->print(i);
                                client->print("&x=");
                                client->print(face.x);
                                client->print("&y=");
                                client->print(face.y);
                                client->print("&w=");
                                client->print(face.width);
                                client->print("&h=");
                                client->print(face.height);

                                if (face.hasKeypoints()) {
                                    client->print("&le_x=");
                                    client->print(face.leftEye.x);
                                    client->print("&le_y=");
                                    client->print(face.leftEye.y);
                                    client->print("&re_x=");
                                    client->print(face.rightEye.x);
                                    client->print("&re_y=");
                                    client->print(face.rightEye.y);
                                    client->print("&n_x=");
                                    client->print(face.nose.x);
                                    client->print("&n_y=");
                                    client->print(face.nose.y);
                                    client->print("&lm_x=");
                                    client->print(face.leftMouth.x);
                                    client->print("&lm_y=");
                                    client->print(face.leftMouth.y);
                                    client->print("&rm_x=");
                                    client->print(face.rightMouth.x);
                                    client->print("&rm_y=");
                                    client->print(face.rightMouth.y);
                                }

                                client->print("|");
                            });
                        }, 8000);
                    }
            };
        }
    }
}

namespace eloq {
    namespace viz {
        static Eloquent::Esp32cam::Viz::FaceDetectionStream faceStream;
    }
}

#endif